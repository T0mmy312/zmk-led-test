## Kconfig
```kconfig
menuconfig LED_BLINK
    bool "led blink"
  select SPI
    help
      Enable led blink.

#if LED_BLINK
```

## dts/bindings/led_blink.yml
```yaml
description: |
  a led blink device triggered by a rising edge interrupt

compatible: led-blink-driver

properties:
  led-gpios:
    type: phandle-array
    required: true
  irq-gpios:
    type: phandle-array
    required: true
```

## west.yml
```yaml
manifest:
  remotes:
    - name: zmk-led-test-origin
      url-base: https://github.com/T0mmy312/zmk-led-test.git
  projects:
    # Together with the above defined remote, this refers to a module located at
    # https://github.com/remote-name/repository-name
    - name: zmk-led-test
      remote: zmk-led-test-origin
      # This points to a west manifest file in the remote module for further imports
      import: west.yml
```
